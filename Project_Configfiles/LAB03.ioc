# file: LAB03.ioc
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Mcu.Family=STM32F0
Mcu.Name=STM32F072R(8-B)Tx
Mcu.Package=LQFP64
ProjectManager.HeapSize=0x200
ProjectManager.StackSize=0x400
ProjectManager.TargetToolchain=MDK-ARM V5
board=custom

// file: Core/Src/main.c
/* USER CODE BEGIN Header */
/**
  ******************************************************************************
  * @file           : main.c
  * @brief          : Main program body
  ******************************************************************************
  * @attention
  *
  * Copyright (c) 2024 STMicroelectronics.
  * All rights reserved.
  *
  * This software is licensed under terms that can be found in the LICENSE file
  * in the root directory of this software component.
  * If no LICENSE file comes with this software, it is provided AS-IS.
  *
  ******************************************************************************
  */
/* USER CODE END Header */
#include "main.h"

void SystemClock_Config(void);

int main(void)
{

	//Configure LEDs
	RCC->AHBENR |= (1<<19); //Enable the 19th bit for clock
	//GPIOC->MODER |= (85<<12);

	GPIOC->MODER |= (90<<12);
	GPIOC->OTYPER &= 0;
	GPIOC->OSPEEDR &= 0;
	GPIOC->PUPDR &= 0;

  /* MCU Configuration--------------------------------------------------------*/

  /* Reset of all peripherals, Initializes the Flash interface and the Systick. */
  HAL_Init();

  /* USER CODE BEGIN Init */

	RCC->APB1ENR |= 3; //Enable TIM2 and TIM3

	TIM2->DIER |= 1; // Enabele update interrupt for TIM2

	__NVIC_EnableIRQ(TIM2_IRQn); //Enables
  /* USER CODE END Init */

  /* Configure the system clock */
  SystemClock_Config();

  /* USER CODE BEGIN SysInit */

	//***********************************************************************
	//Clock frequency 4Hz
	//Clock period .25s or 250ms
	//Divide by 8000 to reduce frequency to 1kHz giving 1ms per cound
	TIM2->PSC = 7999;
	TIM2->ARR = 250; // 0xFA , 250 , Modify to achieve the 4Hz

	TIM3->PSC = 249;
	TIM3->ARR = 40;

	//Start the timer.
	TIM2->CR1 |= 1;

	//Set Green LED high
	GPIOC->BSRR |= (1<<9);

	//Set CCMR to output on channels 1 and 2.
	TIM3->CCMR1 &= ~TIM_CCMR1_CC1S;
	TIM3->CCMR1 &= ~TIM_CCMR1_CC2S;

	TIM3->CCMR1 |= TIM_CCMR1_OC1M;
	TIM3->CCMR1 |= (6 << 12); // SET OC2M PWM output 1 mode.

	//Enabling preload for both channels.
	TIM3->CCMR1 |= TIM_CCMR1_OC1PE;
	TIM3->CCMR1 |= TIM_CCMR1_OC2PE;

	//Enables output in CCER register.
	TIM3->CCER |= TIM_CCER_CC1E;
	TIM3->CCER |= TIM_CCER_CC2E;

	//Set the alternate function mode.
	TIM3->CCR1 = 8;
	TIM3->CCR2 = 8;

	//Configure pin
	GPIOC->AFR[0] &= ~GPIO_AFRL_AFSEL6; // Check this if non working
	GPIOC->AFR[0] &= ~GPIO_AFRL_AFSEL7;
	//***********************************************************************

	TIM3->CR1 |= TIM_CR1_CEN;

  /* USER CODE END SysInit */

  /* Initialize all configured peripherals */

  /* Infinite loop */
  while (1)
  {

  }
}

//Tim2 Handler
void TIM2_IRQHandler(void){

	HAL_GPIO_TogglePin(GPIOC, GPIO_PIN_8 | GPIO_PIN_9);

	 TIM2->SR &= ~TIM_SR_UIF;
}

void SystemClock_Config(void)
{
  RCC_OscInitTypeDef RCC_OscInitStruct = {0};
  RCC_ClkInitTypeDef RCC_ClkInitStruct = {0};

  /** Initializes the RCC Oscillators according to the specified parameters
  * in the RCC_OscInitTypeDef structure.
  */
  RCC_OscInitStruct.OscillatorType = RCC_OSCILLATORTYPE_HSI;
  RCC_OscInitStruct.HSIState = RCC_HSI_ON;
  RCC_OscInitStruct.HSICalibrationValue = RCC_HSICALIBRATION_DEFAULT;
  RCC_OscInitStruct.PLL.PLLState = RCC_PLL_NONE;
  if (HAL_RCC_OscConfig(&RCC_OscInitStruct) != HAL_OK)
  {
    Error_Handler();
  }

  /** Initializes the CPU, AHB and APB buses clocks
  */
  RCC_ClkInitStruct.ClockType = RCC_CLOCKTYPE_HCLK|RCC_CLOCKTYPE_SYSCLK
                              |RCC_CLOCKTYPE_PCLK1;
  RCC_ClkInitStruct.SYSCLKSource = RCC_SYSCLKSOURCE_HSI;
  RCC_ClkInitStruct.AHBCLKDivider = RCC_SYSCLK_DIV1;
  RCC_ClkInitStruct.APB1CLKDivider = RCC_HCLK_DIV1;

  if (HAL_RCC_ClockConfig(&RCC_ClkInitStruct, FLASH_LATENCY_0) != HAL_OK)
  {
    Error_Handler();
  }
}

void Error_Handler(void)
{
  __disable_irq();
  while (1)
  {
  }
}
